## boards/riscv/rs_rvcgra/Kconfig.board
```kconfig
# SPDX-License-Identifier: Apache-2.0

config BOARD_RS_RVCGRA_VC707
	bool "RS RV-CGRA on Xilinx VC707"
	depends on SOC_SERIES_RS_RVCGRA
	select SOC_RISCV_RS_RVCGRA_IMA

config BOARD_RS_RVCGRA_NEXYSVIDEO
	bool "RS RV-CGRA on Digilent Nexys Video"
	depends on SOC_SERIES_RS_RVCGRA
	select SOC_RISCV_RS_RVCGRA_IMA
```

## boards/riscv/rs_rvcgra/Kconfig.defconfig
```kconfig
# SPDX-License-Identifier: Apache-2.0

if BOARD_RS_RVCGRA_NEXYSVIDEO || BOARD_RS_RVCGRA_VC707

config BOARD
	default "rs_rvcgra_nexysvideo" if BOARD_RS_RVCGRA_NEXYSVIDEO
	default "rs_rvcgra_vc707" if BOARD_RS_RVCGRA_VC707

config THREAD_LOCAL_STORAGE
	default y


endif # BOARD_RS_RVCGRA_NEXYSVIDEO || BOARD_RS_RVCGRA_VC707
```

## boards/riscv/rs_rvcgra/rs_rvcgra_defconfig
```kconfig
# SPDX-License-Identifier: Apache-2.0

CONFIG_SOC_SERIES_RS_RVCGRA=y
CONFIG_SOC_RS_RVCGRA_IMA=y
CONFIG_CONSOLE=y
CONFIG_SERIAL=y
CONFIG_UART_NS16550=y
CONFIG_UART_CONSOLE=y
CONFIG_PLIC=y
CONFIG_RISCV_MACHINE_TIMER=y
CONFIG_STACK_SENTINEL=y
CONFIG_XIP=n
CONFIG_RISCV_PMP=n
CONFIG_USERSPACE=n
CONFIG_RUNTIME_ERROR_CHECKS=y
```

## boards/riscv/rs_rvcgra/rs_rvcgra_nexysvideo_defconfig
```kconfig
# SPDX-License-Identifier: Apache-2.0

CONFIG_SOC_SERIES_RS_RVCGRA=y
CONFIG_SOC_RS_RVCGRA_IMA=y
CONFIG_CONSOLE=y
CONFIG_SERIAL=y
CONFIG_UART_ZIP_WBUART32=y
CONFIG_UART_CONSOLE=y
CONFIG_PLIC=n
CONFIG_RISCV_MACHINE_TIMER=y
CONFIG_STACK_SENTINEL=y
CONFIG_XIP=n
CONFIG_RISCV_PMP=n
CONFIG_USERSPACE=n
CONFIG_RUNTIME_ERROR_CHECKS=y
```

## drivers/serial/Kconfig.zip_wbuart32
```kconfig
# NEORV32 UART configuration

# Copyright (c) 2021 Henrik Brix Andersen <henrik@brixandersen.dk>
# SPDX-License-Identifier: Apache-2.0

config UART_ZIP_WBUART32
	bool "ZipCPU wbuart32 UART"
	select SERIAL_HAS_DRIVER
	select SERIAL_SUPPORT_INTERRUPT
	select SERIAL_SUPPORT_ASYNC
	help
	  This option enables the UART driver for ZipCPU wbuart32 compatible ports.
```

## dts/bindings/serial/zip,wbuart32.yaml
```yaml
# Copyright (c) 2018 - 2019 Antmicro <www.antmicro.com>
# SPDX-License-Identifier: Apache-2.0

description: ZipCPU wbuart32

compatible: "zip,wbuart32"

include: uart-controller.yaml

properties:
    reg:
      required: true

    interrupts:
      required: true

    interrupt-names:
      required: true

    interrupt-no-connect-driver:
      type: boolean
      required: false

    rx-fifo-lglen:
      type: int
      required: true

    tx-fifo-lglen:
      type: int
      required: true
```

## dts/bindings/video/tudrs,simple-framebuffer.yaml
```yaml
# Copyright (c) 2020, FrankLi Limited
# SPDX-License-Identifier: Apache-2.0

description: RS Simple Framebuffer

compatible: "tudrs,simple-framebuffer"

include: base.yaml
```

## soc/riscv/riscv-privilege/rs_rvcgra/Kconfig.defconfig.series
```kconfig
# Copyright (c) 2020 Cobham Gaisler AB
# SPDX-License-Identifier: Apache-2.0

if SOC_SERIES_RS_RVCGRA

config SOC_SERIES
	default "rs_rvcgra"

config SYS_CLOCK_HW_CYCLES_PER_SEC
	default 100000000

config RISCV_MACHINE_TIMER_MIN_DELAY
	default 1000

config RISCV_SOC_INTERRUPT_INIT
	default y

config RISCV_HAS_CPU_IDLE
	default y

config RISCV_HAS_PLIC
	default n

config RISCV_GP
	default y

config 2ND_LVL_ISR_TBL_OFFSET
	default 12

config 2ND_LVL_INTR_00_OFFSET
	default 11

config MAX_IRQ_PER_AGGREGATOR
	default 52

config NUM_IRQS
	default 32

config ARCH_IRQ_VECTOR_TABLE_ALIGN
	default 128

config PMP_SLOTS
	default 16

endif
```

## soc/riscv/riscv-privilege/rs_rvcgra/Kconfig.series
```kconfig
# Copyright (c) 2020 Cobham Gaisler AB
# SPDX-License-Identifier: Apache-2.0

config SOC_SERIES_RS_RVCGRA
	bool "RS RV-CGRA Systems"
	select RISCV
	select SOC_FAMILY_RISCV_PRIVILEGE
	select RISCV_ISA_RV32I
	select ARCH_HAS_USERSPACE
	select CPU_HAS_MPU
	select MPU
	select SRAM_REGION_PERMISSIONS
```

## soc/riscv/riscv-privilege/rs_rvcgra/Kconfig.soc
```kconfig
# Copyright (c) 2020 Cobham Gaisler AB
# SPDX-License-Identifier: Apache-2.0

choice
	prompt "RS RV-CGRA Systems"
	depends on SOC_SERIES_RS_RVCGRA

config SOC_RS_RVCGRA_IMA
	bool "RS RV-CGRA SoC rv32ima"
	select ATOMIC_OPERATIONS_BUILTIN
	select INCLUDE_RESET_VECTOR
	select RISCV_ISA_EXT_M
	select RISCV_ISA_EXT_A

config SOC_RS_RVCGRA_IMAF
	bool "RS RV-CGRA SoC rv32imaf"
	select ATOMIC_OPERATIONS_BUILTIN
	select INCLUDE_RESET_VECTOR
	select RISCV_ISA_EXT_M
	select RISCV_ISA_EXT_A
	select RISCV_ISA_EXT_F
	select CPU_HAS_FPU

endchoice
```
